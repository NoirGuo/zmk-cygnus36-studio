## boards/shields/wingxsl/Kconfig.defconfig
```kconfig
# Copyright (c) 2022 Duccio Breschi
# SPDX-License-Identifier: MIT

if SHIELD_WINGXSL_LEFT

config ZMK_KEYBOARD_NAME
    default "wingxsl"

config ZMK_SPLIT_ROLE_CENTRAL
    default y

endif

if SHIELD_WINGXSL_LEFT || SHIELD_WINGXSL_RIGHT

config ZMK_SPLIT
    default y

endif
```

## boards/shields/wingxsl/Kconfig.shield
```kconfig
# Copyright (c) 2022 Duccio Breschi
# SPDX-License-Identifier: MIT

config SHIELD_WINGXSL_LEFT
    def_bool $(shields_list_contains,wingxsl_left)

config SHIELD_WINGXSL_RIGHT
    def_bool $(shields_list_contains,wingxsl_right)
```
